#include <Arduino.h>
#include <SPI.h>
#include <string.h>
#include "qrcode.h"
#include "mid_autumn_assets.h"
#include "mid_autumn_message.h"
#include "epd2in9b_V4.h"

static constexpr size_t FRAME_BYTES = (EPD_WIDTH / 8) * EPD_HEIGHT;
static uint8_t blackImage[FRAME_BYTES];
static uint8_t redImage[FRAME_BYTES];
Epd epd;

const uint8_t PORTRAIT[100][11] = {
  { 0x00, 0x00, 0x00, 0x07, 0xFF, 0xFF, 0xFF, 0xE0, 0x00, 0x00, 0x00 },
  { 0x00, 0x00, 0x00, 0x0F, 0xFF, 0xFF, 0xFF, 0xE0, 0x00, 0x00, 0x00 },
  { 0x00, 0x00, 0x00, 0x1F, 0xFF, 0xFF, 0xFF, 0xF0, 0x00, 0x00, 0x00 },
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  { 0x00, 0x00, 0x00, 0x00, 0x00, 0x00, 0x00, 0x00, 0x00, 0x00, 0x00 },
};

const uint8_t ID_TEXT[110][14] = {
  { 0x00, 0x00, 0x00, 0x00, 0x00, 0x00, 0x00, 0x00, 0x00, 0x00, 0x00, 0x00, 0x00, 0x00 },
  { 0x00, 0x08, 0x00, 0x00, 0x00, 0x00, 0x00, 0x00, 0x00, 0x00, 0x00, 0x00, 0x00, 0x00 },
  { 0x00, 0xB4, 0x00, 0x00, 0x00, 0x38, 0x70, 0x10, 0x20, 0x00, 0x00, 0x00, 0x00, 0x00 },
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  { 0x00, 0x00, 0x00, 0x00, 0x00, 0x00, 0x00, 0x00, 0x00, 0x00, 0x00, 0x00, 0x00, 0x00 },
};

void mapLandscapeToBuffer(int x, int y, int& bufferX, int& bufferY) {
  bufferX = y;
  bufferY = EPD_HEIGHT - 1 - x;
}

void setWhitePixel(int x, int y) {
  if (x < 0 || x >= EPD_HEIGHT || y < 0 || y >= EPD_WIDTH) return;
  int bufferX, bufferY;
  mapLandscapeToBuffer(x, y, bufferX, bufferY);
  const size_t index = static_cast<size_t>(bufferY) * (EPD_WIDTH / 8) + bufferX / 8;
  redImage[index] |= static_cast<uint8_t>(0x80 >> (bufferX % 8));
}

void setRedPixel(int x, int y) {
  if (x < 0 || x >= EPD_HEIGHT || y < 0 || y >= EPD_WIDTH) return;
  int bufferX, bufferY;
  mapLandscapeToBuffer(x, y, bufferX, bufferY);
  const size_t index = static_cast<size_t>(bufferY) * (EPD_WIDTH / 8) + bufferX / 8;
  redImage[index] &= static_cast<uint8_t>(~(0x80 >> (bufferX % 8)));
}

void setBlackPixel(int x, int y) {
  if (x < 0 || x >= EPD_HEIGHT || y < 0 || y >= EPD_WIDTH) return;
  int bufferX, bufferY;
  mapLandscapeToBuffer(x, y, bufferX, bufferY);
  const size_t index = static_cast<size_t>(bufferY) * (EPD_WIDTH / 8) + bufferX / 8;
  blackImage[index] &= static_cast<uint8_t>(~(0x80 >> (bufferX % 8)));
}

void drawMoonArt(int x, int y) {
  for (int row = 0; row < 100; ++row) {
    for (int column = 0; column < 84; ++column) {
      setWhitePixel(x + column, y + row);
      if (MOON_ART[row][column / 8] & (0x80 >> (column % 8))) {
        setRedPixel(x + column, y + row);
      }
    }
  }
}

void drawMidAutumnMessage(int x, int y) {
  for (int row = 0; row < 28; ++row) {
    for (int column = 0; column < 160; ++column) {
      if (MID_AUTUMN_MESSAGE[row][column / 8] & (0x80 >> (column % 8))) {
        setBlackPixel(x + column, y + row);
      }
    }
  }
}

/*
void drawMoonLabelText(int x, int y) {
  for (int row = 0; row < 110; ++row) {
    for (int column = 0; column < 108; ++column) {
      if (MOON_LABEL_TEXT[row][column / 8] & (0x80 >> (column % 8))) {
        setWhitePixel(x + column, y + row);
      }
    }
  }
}
*/

void drawQrCode(int x, int y) {
  QRCode qrcode;
  uint8_t qrData[qrcode_getBufferSize(4)];
  qrcode_initText(&qrcode, qrData, 4, ECC_LOW, "中秋節月餅");

  constexpr int scale = 2;
  constexpr int quietZone = 2;
  for (uint8_t row = 0; row < qrcode.size; ++row) {
    for (uint8_t column = 0; column < qrcode.size; ++column) {
      if (!qrcode_getModule(&qrcode, column, row)) continue;
      for (int dx = 0; dx < scale; ++dx) {
        for (int dy = 0; dy < scale; ++dy) {
          setWhitePixel(x + (column + quietZone) * scale + dx,
                        y + (row + quietZone) * scale + dy);
        }
      }
    }
  }
}

void drawMidAutumnLabel() {
  memset(blackImage, 0xFF, sizeof(blackImage));
  // White paper background; red is drawn only where the mythic artwork exists.
  memset(redImage, 0xFF, sizeof(redImage));
  drawMoonArt(106, 0);
  drawMidAutumnMessage(68, 100);
}

void setup() {
  Serial.begin(115200);
  delay(100);
  Serial.println("36_epaper: Mid-Autumn mooncake label");

  if (epd.Init() != 0) {
    Serial.println("e-Paper init failed");
    return;
  }

  drawMidAutumnLabel();
  epd.Display(blackImage, redImage);
  Serial.println("Display complete");
  delay(1000);
  epd.Sleep();
}

void loop() {}
